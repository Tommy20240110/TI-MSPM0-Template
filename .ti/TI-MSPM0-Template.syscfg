/**
 * @cliArgs --board "/ti/boards/LP_MSPM0G3507" --product "mspm0_sdk@2.10.00.04"
 * @versions {"tool":"1.27.1+4634"}
 */

/**
 * Import the modules used in this configuration.
 */
const Board         = scripting.addModule("/ti/driverlib/Board");
const GPIO          = scripting.addModule("/ti/driverlib/GPIO", {}, false);
const GPIO1         = GPIO.addInstance();
const NONMAIN       = scripting.addModule("/ti/driverlib/NONMAIN");
const SYSCTL        = scripting.addModule("/ti/driverlib/SYSCTL");
const ProjectConfig = scripting.addModule("/ti/project_config/ProjectConfig");

/**
 * Write custom configuration values to the imported modules.
 */
const divider7       = system.clockTree["PLL_PDIV"];
divider7.divideValue = 2;

const divider9       = system.clockTree["UDIV"];
divider9.divideValue = 2;

const multiplier2         = system.clockTree["PLL_QDIV"];
multiplier2.multiplyValue = 10;

const mux8       = system.clockTree["HSCLKMUX"];
mux8.inputSelect = "HSCLKMUX_SYSPLL0";

Board.globalFastWakeEn       = true;
Board.configureUnused        = true;
Board.unusedDirection        = "INPUT";
Board.unusedInternalResistor = "PULL_UP";
Board.genPeriphPinFile       = true;
Board.genResourceCSV         = true;
Board.genFileMod.$name       = "ti_driverlib_BoardPins0";
Board.genFileCSV.$name       = "ti_driverlib_ResourcesCSV0";

GPIO1.$name                          = "GPIO_GRP_0";
GPIO1.associatedPins[0].$name        = "PIN_0";
GPIO1.associatedPins[0].assignedPort = "PORTA";
GPIO1.associatedPins[0].assignedPin  = "0";

NONMAIN.nonmainWarning = true;

SYSCTL.clockTreeEn = true;

ProjectConfig.compiler = "gcc";

/**
 * Pinmux solution for unlocked pins/peripherals. This ensures that minor changes to the automatic solver in a future
 * version of the tool will not impact the pinmux you originally saw.  These lines can be completely deleted in order to
 * re-solve from scratch.
 */
Board.peripheral.$suggestSolution            = "DEBUGSS";
Board.peripheral.swclkPin.$suggestSolution   = "j25_expansion.16";
Board.peripheral.swdioPin.$suggestSolution   = "j25_expansion.14";
GPIO1.associatedPins[0].pin.$suggestSolution = "j19_expansion.9";
